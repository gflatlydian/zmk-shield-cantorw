## boards/shields/cantorw/Kconfig.defconfig
```kconfig
if SHIELD_CANTORW_LEFT

config ZMK_KEYBOARD_NAME
	default "CantorW"

config ZMK_SPLIT_ROLE_CENTRAL
	default y

endif

if SHIELD_CANTORW_LEFT || SHIELD_CANTORW_RIGHT

config ZMK_SPLIT
	default y

endif
```

## boards/shields/cantorw/Kconfig.shield
```kconfig
config SHIELD_CANTORW_LEFT
	def_bool $(shields_list_contains,cantorw_left)

config SHIELD_CANTORW_RIGHT
	def_bool $(shields_list_contains,cantorw_right)
```
